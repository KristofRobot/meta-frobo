## conf/distro/frobo.conf
```bitbake
DISTRO_NAME = "frobo"
DISTRO_VERSION = "0.2.0"
BUILDNAME = "${DISTRO_NAME} ${DISTRO_VERSION}"

#Use (older) sunxi-linux kernel
#Should migrate to mainline linux kernel at some point,
#but that needs more testing/debugging; does not work out-of-the-box
#PREFERRED_PROVIDER_u-boot="u-boot-sunxi"
#PREFERRED_PROVIDER_virtual/bootloader="u-boot-sunxi"
#PREFERRED_PROVIDER_virtual/kernel="linux-sunxi"

#Set preferred provider for jpeg
PREFERRED_PROVIDER_jpeg = "libjpeg-turbo"
PREFERRED_PROVIDER_jpeg-native = "libjpeg-turbo-native"

##
# zeroconf: provides avahi-daemon
# opengl: necessary for freenect-camera and freenect-launch
# alsa: sound support
# wifi: wifi support packages (wireless-tools, wpa-supplicant)
# x11: install x server to use for x forwarding
# ${DISTRO_FEATURES_LIBC}: include default libc features set in default-distrovars.inc
# - IMPORTANT, otherwise eglibc will not build
DISTRO_FEATURES = "\
	zeroconf \
	opengl \
	alsa \
	wifi \
	x11 \
	${DISTRO_FEATURES_LIBC} \
	"

#Dont include pulseaudio
DISTRO_FEATURES_BACKFILL_CONSIDERED = "pulseaudio"

PACKAGE_CLASSES = "package_ipk"

DISTRO_FEED_URI = "http://robo.local:4000"

##
# commercial_gst-plugins-ugly: required for sound-play
# commercial_libmad: required for gst-plugins-ugly
# commercial_mpeg2dec: required for gst-plugins-ugly
# commercial_lame: required for gst-plugins-ugly
LICENSE_FLAGS_WHITELIST = "\
 commercial_libav \ 
 commercial_x264 \
 commercial_gst-plugins-ugly \
 commercial_libmad \
 commercial_mpeg2dec \
 commercial_lame \
 "

DEFAULTTUNE_cubieboard2 ?= "cortexa7hf-neon-vfpv4"
ARM_KEEP_OABI ?= "0"

##
#ssh-server-openssh: provide openssh server
#package-management: provide package management
EXTRA_IMAGE_FEATURES += "\
        ssh-server-openssh \
        package-management \
        "

##
# kernel-module-rt2800usb: kernel module for wifi device
# linux-firmware and linux-firmware-ralink: firmware for wifi device (both seem necessary)
# kernel-module-cp210x: kernel module for usbo to serial dongle
# feed-config-opkg: configure package feed
# ntpdate: allow syncing time with server
# alsa-state: provides asound.conf and saves alsa state
# packagegroup-frobo: frobo specific packages
# kernel-module-snd-usb-audio: kernel module for usb audio device 
# xeyes: allow easy testing of remote x session (x forwarding)
# kernel-module-cdc-acm: necessary to support Arduino USB port as /dev/ttyACM
DISTRO_EXTRA_RDEPENDS += "\
	kernel-module-rt2800usb \
	linux-firmware linux-firmware-ralink \
	feed-config-opkg \
	ntpdate \
	alsa-state \
	packagegroup-frobo \
	kernel-module-snd-usb-audio \
	xeyes \
	kernel-module-cdc-acm \
	"

#autoload ethernet module at boot
KERNEL_MODULE_AUTOLOAD += "rt2800usb"
```

## conf/layer.conf
```bitbake
# We have a conf and classes directory, add to BBPATH
BBPATH .= ":${LAYERDIR}"

# We have recipes-* directories, add to BBFILES
BBFILES += "${LAYERDIR}/recipes-*/*/*.bb \
	${LAYERDIR}/recipes-*/*/*.bbappend"

BBFILE_COLLECTIONS += "frobo-layer"
BBFILE_PATTERN_frobo-layer = "^${LAYERDIR}/"
BBFILE_PRIORITY_frobo-layer = "20"
```
